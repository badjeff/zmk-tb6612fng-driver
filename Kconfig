## Kconfig
```kconfig
# Copyright (c) 2024 The ZMK Contributors
# SPDX-License-Identifier: MIT

DT_COMPAT_TB6612FNG := toshiba,tb6612fng

config TB6612FNG
  bool "TB6612FNG haptic motor driver"
  default $(dt_compat_enabled,$(DT_COMPAT_TB6612FNG))
  select PWM
  help
      Enable TB6612FNG haptic motor driver.

if TB6612FNG

DT_COMPAT_ZMK_BEHAVIOR_TB6612FNG := zmk,behavior-tb6612fng
config ZMK_BEHAVIOR_TB6612FNG
    bool
    default $(dt_compat_enabled,$(DT_COMPAT_ZMK_BEHAVIOR_TB6612FNG))

module = TB6612FNG
module-str = TB6612FNG
source "${ZEPHYR_BASE}/subsys/logging/Kconfig.template.log_config"

endif #TB6612FNG
```

## dts/bindings/toshiba,tb6612fng.yml
```yaml
# Copyright (c) 2024 The ZMK Contributors
# SPDX-License-Identifier: MIT

description: |
  Sensor driver for the TB6612FNG Motor Driver

compatible: "toshiba,tb6612fng"

include: [base.yaml, pinctrl-device.yaml]

properties:
  enable-gpios:
    type: phandle-array
    description: STANBY pin on TB6612FNG
  ain1-gpios:
    type: phandle-array
  ain2-gpios:
    type: phandle-array
  bin1-gpios:
    type: phandle-array
  bin2-gpios:
    type: phandle-array
  pwms:
    type: phandle-array
    description: PWM specifier driving the output.
```

## dts/bindings/zmk,behavior-drv883x.yaml
```yaml
description: HID IO key press behavior

compatible: "zmk,behavior-tb6612fng"

include: two_param.yaml

properties:
  tb6612fng-dev:
    type: phandle
    required: true
  vel-neutral:
    type: int
    default: 128
  vel-min-max:
    type: int
    default: 128
```
